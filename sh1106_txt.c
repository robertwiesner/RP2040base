
#include "sh1106.h"
#include <string.h>

static const unsigned char aaFont[][5] = {
0x00, 0x00, 0x00, 0x00, 0x00,
0x00, 0x00, 0x5F, 0x00, 0x00,
0x00, 0x07, 0x00, 0x07, 0x00,
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0x02, 0x01, 0x02, 0x04, 0x02
};

extern tLCD LCD_lcd;
int LCD_text(int sx, int sy, const char *pText)
{
	int y = sy / 8;
	LCD_lcd.aaBuffer[y][0] = 1;
	if ((sy & 7) == 0) {
		// single line change
		unsigned char *pDst = LCD_lcd.aaBuffer[y] + 4 + sx;
		while (*pText && sx < LCD_MAX_X) {
			char c = *pText++;
			if (' ' <= c && c <= '~') {
				const unsigned char *pSrc = aaFont[c - 0x20];
				for (int cx = 0; cx < 5 && sx < LCD_MAX_X; cx++, sx++) {
					*pDst++ = *pSrc++;
				}
				if (sx < LCD_MAX_X && *pText) {
					*pDst++ = 0;
					sx++;
				}
			}
		}
	} else {
		// two lines
		unsigned char *pDst0 = LCD_lcd.aaBuffer[y] + 4 + sx;
		unsigned char *pDst1 = LCD_lcd.aaBuffer[y+1] + 4 + sx;
		int shift = sy & 7;
		int mask = ~(0xff << shift);

		LCD_lcd.aaBuffer[y+1][0] = 1;

		while (*pText && sx < LCD_MAX_X) {
			char c = *pText++;
			if (' ' <= c && c <= '~') {
				const unsigned char *pSrc = aaFont[c - 0x20];
				for (int cx = 0; cx < 5 && sx < LCD_MAX_X; cx++, sx++) {
					unsigned int ch = *pSrc++ << shift;
					unsigned int val = (*pDst1 << 8) | *pDst0;

					val = (val & mask) | ch;
					*pDst0++ = val;
					*pDst1++ = val >> 8;
				}
				if (sx < LCD_MAX_X && *pText) {
					*pDst0++ &= mask;
					*pDst1++ &= mask >> 8;
					sx++;
				}
			}
		}
	}

	return sx;
}


int
LCD_number(int sx, int sy, int digits, int base, int number)
{
	static const char aHex[] = "0123456789abcdef";
	char aBuffer[33];
	char *pPtr = aBuffer + sizeof(aBuffer);
	*--pPtr = 0;
	base = 1 < base && base <= 16 ? base : 16;
	int sign = number < 0 ? '-' : 0;
	number = number < 0 ? -number : number;
	do {
		int idx = number % base;
		*--pPtr = aHex[idx];
		number /= base;
	} while (--digits && number);

	if (sign && digits) {
		*--pPtr = sign;
		digits--;
	}
	while (0 < digits--) {
		*--pPtr = ' ';
	}

	return LCD_text(sx, sy, pPtr);
}


int
LCD_number_dot(int sx, int sy, int digits, int base, int number, int dotPos)
{
	static const char aHex[] = "0123456789abcdef";
	char aBuffer[34];
	char *pPtr = aBuffer + sizeof(aBuffer);
	*--pPtr = 0;
	int chrCnt = 0;
	do {
		*--pPtr = aHex[number % base];
		chrCnt++;
		number /= base;
		if (0 == --dotPos) {
			*--pPtr = '.';
			chrCnt++;
		}
	} while (aBuffer < pPtr && number);

	if (digits < chrCnt) {
		pPtr[digits+1] = 0;
	} else {
		while (chrCnt < digits) {
			*--pPtr = ' ';
			chrCnt++;
		}
	}

	return LCD_text(sx, sy, pPtr);
}


